// SPDX-License-Identifier: GPL-2.0
/*
 * Copyright (C) 2022 IO Stuff
 * Author: Michiel
 */
 
/dts-v1/;

#include "imx6ull.dtsi"
#include "imx6ull-tios-v1.dtsi"

/ {
	model = "i.MX6 ULL TIOS Board";
	compatible = "fsl,imx6ull";
};

&clks {
	assigned-clocks = <&clks IMX6UL_CLK_PLL3_PFD2>;
	assigned-clock-rates = <320000000>;
};